## boards/dergraph/ibuttonmini/Kconfig.ibuttonmini
```kconfig
# Copyright (c) 2023 Nordic Semiconductor ASA

# SPDX-License-Identifier: Apache-2.0


config BOARD_IBUTTONMINI_NRF51822
	bool "iButton Mini Board"
	select SOC_NRF51822_QFAA
```

## boards/dergraph/ibuttonmini/board.yml
```yaml
board:
  name: ibuttonmini
  full_name: iButton mini
  vendor: derGraph
  socs:
  - name: nrf51822
```

## modules/google_fhd/Kconfig
```kconfig
# Create a new option in menuconfig
config GOOGLE_FHD
    bool "Basic print test to console"
    default n   # Set the library to be disabled by default
    default n if MBEDTLS && MBEDTLS_BUILTIN && CUSTOM_MBEDTLS_CFG_FILE

    help
        Adds say_hello() function to print a basic message to the console.
```

## modules/say_hello/Kconfig
```kconfig
# Create a new option in menuconfig
config SAY_HELLO
    bool "Basic print test to console"
    default n   # Set the library to be disabled by default
    depends on PRINTK   # Make it dependent on PRINTK
    help
        Adds say_hello() function to print a basic message to the console.
```
